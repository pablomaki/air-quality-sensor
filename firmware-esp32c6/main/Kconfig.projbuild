## firmware-esp32c6/main/Kconfig.projbuild
```kconfig
menu "Air Quality Sensor"

config AQS_PRODUCT_NAME
    string "Product name"
    default "Air Quality Sensor"
    help
      ProductName reported in the Matter Basic Information cluster. Set per
      variant, alongside a variant specific DEVICE_PRODUCT_ID.

menu "Timing Configuration"

config SAMPLE_INTERVAL_MS
    int "Sensor sampling interval (milliseconds)"
    range 1000 3600000
    default 5000
    help
      How often every enabled sensor is read. This is a property of the sensors
      rather than of reporting: it also sets the sampling interval handed to the
      Sensirion gas index algorithm, which is specified for 1 s and tested up to
      10 s, and it is bounded below at 1000 ms so that the conversion to whole
      seconds stays meaningful.

config REPORT_INTERVAL_MS
    int "Matter reporting interval (milliseconds)"
    range 1000 3600000
    default 60000
    help
      How often the Matter cluster attributes are refreshed from the buffered
      samples. Together with SAMPLE_INTERVAL_MS this also sets how many samples
      are averaged into each reported value: one reporting period's worth, so
      every sample contributes to exactly one report. Note that when a controller
      actually receives values is governed by its own subscription min/max
      intervals, not by this value.

config SENSOR_WARMUP_TIME_MS
    int "Sensor warmup time (milliseconds)"
    default 5000
    help
      Warmup time for sensors in milliseconds. Required by SGP40 for consistent readings.

endmenu

menu "Factory Reset Configuration"

config FACTORY_RESET_POWER_CYCLES
    int "Power cycles in succession that trigger a factory reset"
    range 3 10
    default 5
    help
      The power supply is the only control a sealed unit offers. Power cycling
      the device this many times, each within
      FACTORY_RESET_POWER_CYCLE_WINDOW_MS of the previous boot, erases the
      Matter configuration and leaves the device uncommissioned. The lower bound
      keeps a couple of genuine restarts from reaching the count.

config FACTORY_RESET_POWER_CYCLE_WINDOW_MS
    int "Window for a power cycle to count towards a reset (milliseconds)"
    range 1000 30000
    default 5000
    help
      How long the device has to stay up before the boot count is dropped. Long
      enough to power cycle deliberately, short enough that restarts spread over
      an ordinary working session never accumulate.

config FACTORY_RESET_BUTTON_HOLD_MS
    int "BOOT button hold time that triggers a factory reset (milliseconds)"
    range 2000 30000
    default 5000
    help
      Holding the XIAO's BOOT button this long factory resets the device, the
      same as the power cycle gesture. The button only acts as a boot strap
      while the device comes out of reset, so it is free to read afterwards.

endmenu

menu "Thread Configuration"

config THREAD_DETACHED_REBOOT_MINUTES
    int "Reboot after being detached from Thread this long (minutes)"
    range 0 1440
    default 10
    help
      A commissioned device that stays detached from its Thread network this
      long reboots. The radio has been seen to stop being heard by its parent
      under sustained traffic and not recover until a reset, while a fresh boot
      reattaches within seconds. 0 disables the reboot. With the whole network
      down the device keeps rebooting at this interval until it comes back,
      which costs nothing but the reboots.

config THREAD_DIAGNOSTICS_INTERVAL_S
    int "Thread radio diagnostics log interval (seconds)"
    range 0 3600
    default 30
    help
      How often the Thread role, the link to the parent and the radio counters
      accumulated since the previous line are logged. 0 disables the log; the
      detached reboot keeps working regardless, checked on the same interval or
      every 30 s when the log is off.

endmenu

menu "Peripheral Configuration"

config ENABLE_EVENT_LED
    bool "Enable event LED"
    default y
    help
      Blink the onboard user LED on initialization, startup and sampling events.

# Selected per variant in variants/<name>.defaults. Unlike the nRF build there
# is no devicetree to derive them from, so these are the single source of truth
# for which parts are fitted.

config ENABLE_SHT4X
    bool "Enable SHT4X sensor"
    help
      Enable the SHT4X temperature/humidity sensor at I2C address 0x44.

config ENABLE_SGP40
    bool "Enable SGP40 sensor"
    help
      Enable the SGP40 VOC sensor at I2C address 0x59.

config ENABLE_SCD4X
    bool "Enable SCD4X sensor"
    help
      Enable the SCD4X CO2 sensor at I2C address 0x62.

config ENABLE_BMP390
    bool "Enable BMP390 sensor"
    depends on !ENABLE_BME680
    help
      Enable the BMP390 pressure sensor at I2C address 0x77. Shares its address
      with the BME680, so the two cannot be fitted together.

config ENABLE_BME680
    bool "Enable BME680 sensor"
    help
      Enable the BME680 at I2C address 0x77, processed by the Bosch BSEC library
      into an IAQ index. Needs the BSEC release pointed to by BSEC_DIR at build time.

endmenu

menu "SCD4X Sensor Configuration"
    depends on ENABLE_SCD4X

config SCD4X_ALTITUDE
    int "Altitude (meters)"
    default 10
    help
      Altitude in meters. Only used if pressure is not provided by other sensors.

config SCD4X_TEMPERATURE_OFFSET_MILLI_C
    int "Temperature offset (milli-degrees Celsius)"
    range 0 20000
    default 0
    help
      Compensates the SCD4x self heating: reported temperature = measured -
      offset. Expressed in milli-degrees because Kconfig has no float type, so
      2.35 degrees is 2350. The sensor resolves about 0.0027 degrees, and the
      sensor rejects anything outside 0 to 20 degrees.

endmenu

menu "BME680 Sensor Configuration"
    depends on ENABLE_BME680

config BME680_TEMPERATURE_OFFSET_CENTI_C
    int "Temperature offset (centi-degrees Celsius)"
    range 0 1000
    default 100
    help
      Heat from the board raises the temperature the BME680 sees. BSEC subtracts
      this offset and corrects humidity to match. 100 is 1.0 degrees, the same
      default as the nRF build's BME68X_IAQ_TEMPERATURE_OFFSET.

config BME680_STATE_SAVE_INTERVAL_MINUTES
    int "BSEC state save interval (minutes)"
    range 10 1440
    default 60
    help
      How often the BSEC calibration state is persisted, so a restart resumes
      with a calibrated IAQ instead of starting over.

endmenu

endmenu
```

## firmware-esp32c6/sdkconfig.defaults
```kconfig
# Seeed XIAO ESP32-C6, Matter over Thread. Variant specifics (sensors, product
# ID and name, timing) live in variants/<name>.defaults, layered on top.
CONFIG_IDF_TARGET="esp32c6"
CONFIG_ESPTOOLPY_FLASHSIZE_4MB=y

# Fixed partition layout, see partitions.csv
CONFIG_PARTITION_TABLE_CUSTOM=y
CONFIG_PARTITION_TABLE_CUSTOM_FILENAME="partitions.csv"
CONFIG_PARTITION_TABLE_FILENAME="partitions.csv"
CONFIG_PARTITION_TABLE_OFFSET=0xC000

# Identity: test vendor, product ID per variant
CONFIG_DEVICE_VENDOR_ID=0xFFF1
CONFIG_CHIP_PROJECT_CONFIG="main/chip_project_config.h"

# BLE for commissioning only, released afterwards
CONFIG_BT_ENABLED=y
CONFIG_BT_NIMBLE_ENABLED=y
CONFIG_BT_NIMBLE_EXT_ADV=n
CONFIG_BT_NIMBLE_HCI_EVT_BUF_SIZE=70
CONFIG_BT_NIMBLE_ENABLE_CONN_REATTEMPT=n
CONFIG_USE_BLE_ONLY_FOR_COMMISSIONING=y

# Thread minimal end device, the role the nRF build uses. Wi-Fi is off.
CONFIG_OPENTHREAD_ENABLED=y
CONFIG_OPENTHREAD_MTD=y
CONFIG_OPENTHREAD_SRP_CLIENT=y
CONFIG_OPENTHREAD_DNS_CLIENT=y
CONFIG_OPENTHREAD_LOG_LEVEL_DYNAMIC=n
CONFIG_OPENTHREAD_LOG_LEVEL_NOTE=y
CONFIG_OPENTHREAD_CLI=n
CONFIG_ENABLE_WIFI_STATION=n
CONFIG_ENABLE_WIFI_AP=n
CONFIG_ESP_WIFI_SOFTAP_SUPPORT=n
CONFIG_LWIP_IPV6_AUTOCONFIG=n
CONFIG_LWIP_IPV6_NUM_ADDRESSES=8
CONFIG_LWIP_MULTICAST_PING=y
CONFIG_USE_MINIMAL_MDNS=n
CONFIG_ENABLE_EXTENDED_DISCOVERY=y

# Matter OTA: requestor, .ota image generation and bootloader rollback. The
# application confirms a new image once it is back on the network.
CONFIG_ENABLE_OTA_REQUESTOR=y
CONFIG_CHIP_OTA_IMAGE_BUILD=y
CONFIG_BOOTLOADER_APP_ROLLBACK_ENABLE=y

# Only images signed with the project key are accepted. No eFuses are burned:
# this is signature checking without secure boot, and stays reversible. The key
# path is supplied by scripts/build_variants.sh, outside the repository.
CONFIG_SECURE_SIGNED_APPS_NO_SECURE_BOOT=y
CONFIG_SECURE_SIGNED_APPS_ECDSA_V2_SCHEME=y
CONFIG_SECURE_BOOT_ECDSA_KEY_LEN_256_BITS=y
CONFIG_SECURE_SIGNED_ON_UPDATE_NO_SECURE_BOOT=y
CONFIG_SECURE_BOOT_BUILD_SIGNED_BINARIES=y

CONFIG_ENABLE_CHIP_SHELL=n
CONFIG_MBEDTLS_HKDF_C=y
CONFIG_LIBSODIUM_USE_MBEDTLS_SHA=y
CONFIG_ESP_MATTER_MAX_DYNAMIC_ENDPOINT_COUNT=4
CONFIG_MAX_GROUP_KEYS_PER_FABRIC=4

CONFIG_COMPILER_OPTIMIZATION_SIZE=y
CONFIG_LOG_DEFAULT_LEVEL_INFO=y

# Clusters this device does not use, excluded to save flash. Taken from the
# esp-matter light example, minus the measurement and air quality clusters.
CONFIG_SUPPORT_ACCOUNT_LOGIN_CLUSTER=n
CONFIG_SUPPORT_ACTIONS_CLUSTER=n
CONFIG_SUPPORT_ACTIVATED_CARBON_FILTER_MONITORING_CLUSTER=n
CONFIG_SUPPORT_APPLICATION_BASIC_CLUSTER=n
CONFIG_SUPPORT_APPLICATION_LAUNCHER_CLUSTER=n
CONFIG_SUPPORT_AUDIO_OUTPUT_CLUSTER=n
CONFIG_SUPPORT_BOOLEAN_STATE_CLUSTER=n
CONFIG_SUPPORT_BOOLEAN_STATE_CONFIGURATION_CLUSTER=n
CONFIG_SUPPORT_BRIDGED_DEVICE_BASIC_INFORMATION_CLUSTER=n
CONFIG_SUPPORT_CAMERA_AV_SETTINGS_USER_LEVEL_MANAGEMENT_CLUSTER=n
CONFIG_SUPPORT_CARBON_MONOXIDE_CONCENTRATION_MEASUREMENT_CLUSTER=n
CONFIG_SUPPORT_CHANNEL_CLUSTER=n
CONFIG_SUPPORT_CHIME_CLUSTER=n
CONFIG_SUPPORT_CLOSURE_CONTROL_CLUSTER=n
CONFIG_SUPPORT_CLOSURE_DIMENSION_CLUSTER=n
CONFIG_SUPPORT_COMMISSIONER_CONTROL_CLUSTER=n
CONFIG_SUPPORT_COMMODITY_METERING_CLUSTER=n
CONFIG_SUPPORT_COMMODITY_PRICE_CLUSTER=n
CONFIG_SUPPORT_COMMODITY_TARIFF_CLUSTER=n
CONFIG_SUPPORT_CONTENT_LAUNCHER_CLUSTER=n
CONFIG_SUPPORT_CONTENT_CONTROL_CLUSTER=n
CONFIG_SUPPORT_CONTENT_APP_OBSERVER_CLUSTER=n
CONFIG_SUPPORT_DEVICE_ENERGY_MANAGEMENT_CLUSTER=n
CONFIG_SUPPORT_DEVICE_ENERGY_MANAGEMENT_MODE_CLUSTER=n
CONFIG_SUPPORT_DIAGNOSTIC_LOGS_CLUSTER=n
CONFIG_SUPPORT_DISHWASHER_ALARM_CLUSTER=n
CONFIG_SUPPORT_DISHWASHER_MODE_CLUSTER=n
CONFIG_SUPPORT_ELECTRICAL_GRID_CONDITIONS_CLUSTER=n
CONFIG_SUPPORT_HUMIDISTAT_CLUSTER=n
CONFIG_SUPPORT_METER_IDENTIFICATION_CLUSTER=n
CONFIG_SUPPORT_MICROWAVE_OVEN_MODE_CLUSTER=n
CONFIG_SUPPORT_DOOR_LOCK_CLUSTER=n
CONFIG_SUPPORT_ECOSYSTEM_INFORMATION_CLUSTER=n
CONFIG_SUPPORT_ELECTRICAL_ENERGY_MEASUREMENT_CLUSTER=n
CONFIG_SUPPORT_ELECTRICAL_POWER_MEASUREMENT_CLUSTER=n
CONFIG_SUPPORT_ENERGY_EVSE_CLUSTER=n
CONFIG_SUPPORT_ENERGY_EVSE_MODE_CLUSTER=n
CONFIG_SUPPORT_ETHERNET_NETWORK_DIAGNOSTICS_CLUSTER=n
CONFIG_SUPPORT_ENERGY_PREFERENCE_CLUSTER=n
CONFIG_SUPPORT_FAN_CONTROL_CLUSTER=n
CONFIG_SUPPORT_FAULT_INJECTION_CLUSTER=n
CONFIG_SUPPORT_FIXED_LABEL_CLUSTER=n
CONFIG_SUPPORT_FLOW_MEASUREMENT_CLUSTER=n
CONFIG_SUPPORT_FORMALDEHYDE_CONCENTRATION_MEASUREMENT_CLUSTER=n
CONFIG_SUPPORT_HEPA_FILTER_MONITORING_CLUSTER=n
CONFIG_SUPPORT_ICD_MANAGEMENT_CLUSTER=n
CONFIG_SUPPORT_ILLUMINANCE_MEASUREMENT_CLUSTER=n
CONFIG_SUPPORT_JOINT_FABRIC_DATASTORE_CLUSTER=n
CONFIG_SUPPORT_JOINT_FABRIC_ADMINISTRATOR_CLUSTER=n
CONFIG_SUPPORT_KEYPAD_INPUT_CLUSTER=n
CONFIG_SUPPORT_LAUNDRY_WASHER_MODE_CLUSTER=n
CONFIG_SUPPORT_LOCALIZATION_CONFIGURATION_CLUSTER=n
CONFIG_SUPPORT_LOW_POWER_CLUSTER=n
CONFIG_SUPPORT_MEDIA_INPUT_CLUSTER=n
CONFIG_SUPPORT_MEDIA_PLAYBACK_CLUSTER=n
CONFIG_SUPPORT_MICROWAVE_OVEN_CONTROL_CLUSTER=n
CONFIG_SUPPORT_MESSAGES_CLUSTER=n
CONFIG_SUPPORT_MODE_SELECT_CLUSTER=n
CONFIG_SUPPORT_NETWORK_IDENTITY_MANAGEMENT_CLUSTER=n
CONFIG_SUPPORT_NITROGEN_DIOXIDE_CONCENTRATION_MEASUREMENT_CLUSTER=n
CONFIG_SUPPORT_PROXIMITY_RANGING_CLUSTER=n
CONFIG_SUPPORT_PUSH_AV_STREAM_TRANSPORT_CLUSTER=n
CONFIG_SUPPORT_SAMPLE_MEI_CLUSTER=n
CONFIG_SUPPORT_OCCUPANCY_SENSING_CLUSTER=n
CONFIG_SUPPORT_POWER_TOPOLOGY_CLUSTER=n
CONFIG_SUPPORT_OPERATIONAL_STATE_CLUSTER=n
CONFIG_SUPPORT_OPERATIONAL_STATE_OVEN_CLUSTER=n
CONFIG_SUPPORT_OPERATIONAL_STATE_RVC_CLUSTER=n
CONFIG_SUPPORT_OVEN_MODE_CLUSTER=n
CONFIG_SUPPORT_OZONE_CONCENTRATION_MEASUREMENT_CLUSTER=n
CONFIG_SUPPORT_PM10_CONCENTRATION_MEASUREMENT_CLUSTER=n
CONFIG_SUPPORT_PM1_CONCENTRATION_MEASUREMENT_CLUSTER=n
CONFIG_SUPPORT_PM2_5_CONCENTRATION_MEASUREMENT_CLUSTER=n
CONFIG_SUPPORT_POWER_SOURCE_CLUSTER=n
CONFIG_SUPPORT_POWER_SOURCE_CONFIGURATION_CLUSTER=n
CONFIG_SUPPORT_PUMP_CONFIGURATION_AND_CONTROL_CLUSTER=n
CONFIG_SUPPORT_RADON_CONCENTRATION_MEASUREMENT_CLUSTER=n
CONFIG_SUPPORT_REFRIGERATOR_ALARM_CLUSTER=n
CONFIG_SUPPORT_REFRIGERATOR_AND_TEMPERATURE_CONTROLLED_CABINET_MODE_CLUSTER=n
CONFIG_SUPPORT_RVC_CLEAN_MODE_CLUSTER=n
CONFIG_SUPPORT_RVC_RUN_MODE_CLUSTER=n
CONFIG_SUPPORT_SERVICE_AREA_CLUSTER=n
CONFIG_SUPPORT_SMOKE_CO_ALARM_CLUSTER=n
CONFIG_SUPPORT_SOFTWARE_DIAGNOSTICS_CLUSTER=n
CONFIG_SUPPORT_SOIL_MEASUREMENT_CLUSTER=n
CONFIG_SUPPORT_SWITCH_CLUSTER=n
CONFIG_SUPPORT_TARGET_NAVIGATOR_CLUSTER=n
CONFIG_SUPPORT_TEMPERATURE_CONTROL_CLUSTER=n
CONFIG_SUPPORT_THERMOSTAT_CLUSTER=n
CONFIG_SUPPORT_THERMOSTAT_USER_INTERFACE_CONFIGURATION_CLUSTER=n
CONFIG_SUPPORT_TIME_FORMAT_LOCALIZATION_CLUSTER=n
CONFIG_SUPPORT_TIME_SYNCHRONIZATION_CLUSTER=n
CONFIG_SUPPORT_TIMER_CLUSTER=n
CONFIG_SUPPORT_TLS_CERTIFICATE_MANAGEMENT_CLUSTER=n
CONFIG_SUPPORT_TLS_CLIENT_MANAGEMENT_CLUSTER=n
CONFIG_SUPPORT_TVOC_CONCENTRATION_MEASUREMENT_CLUSTER=n
CONFIG_SUPPORT_UNIT_LOCALIZATION_CLUSTER=n
CONFIG_SUPPORT_UNIT_TESTING_CLUSTER=n
CONFIG_SUPPORT_USER_LABEL_CLUSTER=n
CONFIG_SUPPORT_VALVE_CONFIGURATION_AND_CONTROL_CLUSTER=n
CONFIG_SUPPORT_WAKE_ON_LAN_CLUSTER=n
CONFIG_SUPPORT_LAUNDRY_WASHER_CONTROLS_CLUSTER=n
CONFIG_SUPPORT_LAUNDRY_DRYER_CONTROLS_CLUSTER=n
CONFIG_SUPPORT_WEB_RTC_TRANSPORT_PROVIDER_CLUSTER=n
CONFIG_SUPPORT_WEB_RTC_TRANSPORT_REQUESTOR_CLUSTER=n
CONFIG_SUPPORT_WIFI_NETWORK_MANAGEMENT_CLUSTER=n
CONFIG_SUPPORT_WINDOW_COVERING_CLUSTER=n
CONFIG_SUPPORT_WATER_HEATER_MANAGEMENT_CLUSTER=n
CONFIG_SUPPORT_WATER_HEATER_MODE_CLUSTER=n
CONFIG_SUPPORT_ZONE_MANAGEMENT_CLUSTER=n
CONFIG_SUPPORT_AMBIENT_CONTEXT_SENSING_CLUSTER=n
CONFIG_SUPPORT_CAMERA_AV_STREAM_MANAGEMENT_CLUSTER=n
CONFIG_SUPPORT_MEDIA_FILE_MANAGEMENT_CLUSTER=n

# Application timing, as in the nRF prj.conf
CONFIG_SAMPLE_INTERVAL_MS=30000
CONFIG_REPORT_INTERVAL_MS=60000
CONFIG_ENABLE_EVENT_LED=y
```
